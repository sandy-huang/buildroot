## configs/rk3668_a55_16k_page_defconfig
```kconfig
BR2_aarch64=y
BR2_cortex_a76_a55=y
BR2_ARM_FPU_VFPV4=y
BR2_ARM64_PAGE_SIZE_16K=y
BR2_TARGET_GENERIC_GETTY_PORT="ttyFIQ0"
BR2_PACKAGE_STRACE=y
BR2_PACKAGE_LIBDRM=y
BR2_PACKAGE_LIBDRM_INSTALL_TESTS=y
BR2_PACKAGE_IO=y
BR2_PACKAGE_LRZSZ=y
BR2_TARGET_ROOTFS_CPIO=y
BR2_TARGET_ROOTFS_CPIO_LZ4=y
```
